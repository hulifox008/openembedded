## conf/machine/cubieboard.conf
```bitbake
#@TYPE: Machine
#@Name: Cubieboard 
#@DESCRIPTION: Machine configuration for Cubieboard


TARGET_ARCH = "arm"

PREFERRED_PROVIDER_virtual/kernel = "linux-sunxi"

# used by sysvinit_2
SERIAL_CONSOLE = "115200 ttyS0"

IMAGE_FSTYPES = "tar.gz"

ARM_FP_ABI = "hardfp"
require conf/machine/include/tune-cortexa8.inc
```
